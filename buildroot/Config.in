## buildroot/Config.in
```kconfig
source "$BR2_EXTERNAL_KELP_PATH/package/kelp-system/Config.in"
source "$BR2_EXTERNAL_KELP_PATH/package/kelp-kmod/Config.in"
source "$BR2_EXTERNAL_KELP_PATH/package/kelp-config/Config.in"
```

## buildroot/configs/kelp_aarch64_defconfig
```kconfig
# Kelp OS aarch64 defconfig for Buildroot
# Target: aarch64 with U-Boot (RPi4/generic ARM)

# Architecture
BR2_aarch64=y

# Toolchain
BR2_TOOLCHAIN_BUILDROOT_GLIBC=y
BR2_KERNEL_HEADERS_6_6=y

# Kernel
BR2_LINUX_KERNEL=y
BR2_LINUX_KERNEL_CUSTOM_VERSION=y
BR2_LINUX_KERNEL_CUSTOM_VERSION_VALUE="6.6.70"
BR2_LINUX_KERNEL_DEFCONFIG="defconfig"
BR2_LINUX_KERNEL_INSTALL_TARGET=y
BR2_LINUX_KERNEL_DTS_SUPPORT=y

# Bootloader — U-Boot
BR2_TARGET_UBOOT=y
BR2_TARGET_UBOOT_BUILD_SYSTEM_KCONFIG=y
BR2_TARGET_UBOOT_CUSTOM_VERSION=y
BR2_TARGET_UBOOT_CUSTOM_VERSION_VALUE="2024.01"
BR2_TARGET_UBOOT_BOARD_DEFCONFIG="rpi_4"

# Filesystem
BR2_TARGET_ROOTFS_EXT2=y
BR2_TARGET_ROOTFS_EXT2_4=y
BR2_TARGET_ROOTFS_EXT2_SIZE="512M"

# Init system — BusyBox init
BR2_INIT_BUSYBOX=y

# System
BR2_SYSTEM_DHCP="eth0"
BR2_TARGET_GENERIC_HOSTNAME="kelp"
BR2_TARGET_GENERIC_ISSUE="Welcome to Kelp OS"
BR2_ROOTFS_OVERLAY="$(BR2_EXTERNAL_KELP_PATH)/board/kelp/rootfs_overlay"
BR2_ROOTFS_POST_BUILD_SCRIPT="$(BR2_EXTERNAL_KELP_PATH)/board/kelp/post_build.sh"

# Core packages
BR2_PACKAGE_BUSYBOX=y
BR2_PACKAGE_DROPBEAR=y
BR2_PACKAGE_DHCPCD=y

# Kelp dependencies
BR2_PACKAGE_OPENSSL=y
BR2_PACKAGE_LIBCURL=y
BR2_PACKAGE_CJSON=y
BR2_PACKAGE_LIBYAML=y
BR2_PACKAGE_SQLITE=y
BR2_PACKAGE_LIBMICROHTTPD=y
BR2_PACKAGE_NCURSES=y

# Kelp packages
BR2_PACKAGE_KELP_SYSTEM=y
BR2_PACKAGE_KELP_KMOD=y
BR2_PACKAGE_KELP_CONFIG=y
```

## buildroot/configs/kelp_x86_64_defconfig
```kconfig
# Kelp OS x86_64 defconfig for Buildroot
# Target: x86_64 with GRUB2 EFI boot

# Architecture
BR2_x86_64=y

# Toolchain
BR2_TOOLCHAIN_BUILDROOT_GLIBC=y
BR2_KERNEL_HEADERS_6_6=y

# Kernel
BR2_LINUX_KERNEL=y
BR2_LINUX_KERNEL_CUSTOM_VERSION=y
BR2_LINUX_KERNEL_CUSTOM_VERSION_VALUE="6.6.70"
BR2_LINUX_KERNEL_USE_CUSTOM_CONFIG=y
BR2_LINUX_KERNEL_CUSTOM_CONFIG_FILE="$(BR2_EXTERNAL_KELP_PATH)/board/kelp/linux-x86_64.config"
BR2_LINUX_KERNEL_INSTALL_TARGET=y

# Bootloader — GRUB2 EFI
BR2_TARGET_GRUB2=y
BR2_TARGET_GRUB2_X86_64_EFI=y

# Filesystem
BR2_TARGET_ROOTFS_EXT2=y
BR2_TARGET_ROOTFS_EXT2_4=y
BR2_TARGET_ROOTFS_EXT2_SIZE="512M"

# Init system — BusyBox init
BR2_INIT_BUSYBOX=y

# System
BR2_SYSTEM_DHCP="eth0"
BR2_TARGET_GENERIC_HOSTNAME="kelp"
BR2_TARGET_GENERIC_ISSUE="Welcome to Kelp OS"
BR2_ROOTFS_OVERLAY="$(BR2_EXTERNAL_KELP_PATH)/board/kelp/rootfs_overlay"
BR2_ROOTFS_POST_BUILD_SCRIPT="$(BR2_EXTERNAL_KELP_PATH)/board/kelp/post_build.sh"
BR2_ROOTFS_POST_IMAGE_SCRIPT="$(BR2_EXTERNAL_KELP_PATH)/board/kelp/post_image.sh"

# Core packages
BR2_PACKAGE_BUSYBOX=y
BR2_PACKAGE_DROPBEAR=y
BR2_PACKAGE_DHCPCD=y

# Kelp dependencies
BR2_PACKAGE_OPENSSL=y
BR2_PACKAGE_LIBCURL=y
BR2_PACKAGE_CJSON=y
BR2_PACKAGE_LIBYAML=y
BR2_PACKAGE_SQLITE=y
BR2_PACKAGE_LIBMICROHTTPD=y
BR2_PACKAGE_NCURSES=y

# Kelp packages
BR2_PACKAGE_KELP_SYSTEM=y
BR2_PACKAGE_KELP_KMOD=y
BR2_PACKAGE_KELP_CONFIG=y

# Image generation
BR2_ROOTFS_POST_SCRIPT_ARGS="$(BR2_EXTERNAL_KELP_PATH)/board/kelp/genimage.cfg"
```

## buildroot/package/kelp-config/Config.in
```kconfig
config BR2_PACKAGE_KELP_CONFIG
	bool "kelp-config"
	help
	  Default configuration files for Kelp OS.
	  Installs /etc/kelp/kelp.yaml.
```

## buildroot/package/kelp-kmod/Config.in
```kconfig
config BR2_PACKAGE_KELP_KMOD
	bool "kelp-kmod"
	depends on BR2_LINUX_KERNEL
	help
	  Kelp OS kernel module (kelp.ko).
	  Provides /dev/kelp chardev, /proc/kelp stats,
	  AI inference scheduler, semantic FS events,
	  and accelerator management stubs.
```

## buildroot/package/kelp-system/Config.in
```kconfig
config BR2_PACKAGE_KELP_SYSTEM
	bool "kelp-system"
	depends on BR2_PACKAGE_OPENSSL
	depends on BR2_PACKAGE_LIBCURL
	depends on BR2_PACKAGE_CJSON
	depends on BR2_PACKAGE_LIBYAML
	depends on BR2_PACKAGE_SQLITE
	depends on BR2_PACKAGE_LIBMICROHTTPD
	help
	  Kelp OS userspace system: libraries, CLI, gateway, TUI, daemon.
	  This is the core AI agent framework that runs on Kelp OS.

	  https://github.com/kelp-os/kelp
```
